## conf/layer.conf
```bitbake
# We have a conf and classes directory, add to BBPATH
BBPATH .= ":${LAYERDIR}"

# We have a packages directory, add to BBFILES
BBFILES += "${LAYERDIR}/recipes-*/*/*.bb \
            ${LAYERDIR}/recipes-*/*/*.bbappend"

BBFILE_COLLECTIONS      += "prophesee"
BBFILE_PATTERN_prophesee   = "^${LAYERDIR}/"

LAYERSERIES_COMPAT_prophesee = "kirkstone"
```
